#include "Max7219LedMatrix.h"
// Bitmap definitions for ASCII characters
const uint8_t ASCII[][8] = {
  { 0x00, 0x00, 0x00, 0x00, 0x00, 0x00, 0x00, 0x00 },  // Space (32)
  { 0x00, 0x00, 0x5F, 0x5F, 0x00, 0x00, 0x00, 0x00 },  // ! (33)
  { 0x00, 0x07, 0x03, 0x00, 0x07, 0x03, 0x00, 0x00 },  // " (34)
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  { 0x08, 0x0C, 0x06, 0x0C, 0x18, 0x0C, 0x08, 0x00 }   // ~ (126)
};
Max7219LedMatrix::Max7219LedMatrix(int clk_pin, int cs_pin, int din_pin) 
  : clk_pin(clk_pin), cs_pin(cs_pin), din_pin(din_pin) {
}
void Max7219LedMatrix::begin() {
  pinMode(clk_pin, OUTPUT);
  pinMode(cs_pin, OUTPUT);
  pinMode(din_pin, OUTPUT);
  digitalWrite(cs_pin, HIGH);
  digitalWrite(clk_pin, LOW);
  digitalWrite(din_pin, LOW);
    
  delay(50);
  // Initialize MAX7219 registers
  write(0x09, 0x00); // No decode mode
  write(0x0a, 0x00); // Medium brightness
  write(0x0b, 0x07); // Scan limit - all digits
  write(0x0c, 0x01); // Normal operation
  write(0x0f, 0x00); // Display test off
  clear();
}

void Max7219LedMatrix::writeByte(uint8_t data) {

  digitalWrite(cs_pin, LOW);
  for (int i = 8; i >= 1; i--) {
    //MAX7219 reads data when CLK goes from LOW to HIGH
    digitalWrite(clk_pin, LOW);
    digitalWrite(din_pin, data & 0x80);  //Sending leftmost bit, 0x80 is the mask
    data = data << 1;                    // shift to left
    digitalWrite(clk_pin, HIGH);
  }
}

void Max7219LedMatrix::write(uint8_t address, uint8_t value) {
    digitalWrite(cs_pin, LOW);
    writeByte(address);
    writeByte(value);
    digitalWrite(cs_pin, HIGH);
}

void Max7219LedMatrix::clear() {
    for (int i = 1; i <= 8; i++) {
        write(i, 0x00);
    }
}
void Max7219LedMatrix::setBrightness(uint8_t brightness) {
    write(0x0A, brightness);
}
void Max7219LedMatrix::printMessage(const char* str, unsigned int delay_ms) {
    if (str == nullptr) return;
    const char *p = str;
    int offset = 32; // ASCII space character
    
    while(*p != '\0') {
      uint8_t ascii_code = (uint8_t)(*p);
      uint8_t* char_data = ASCII[ascii_code - offset];
      for(int i = 1; i <= 7; i++) {
          write(i, char_data[i-1]);
      }
      delay(delay_ms);
      p++;
    }
    // Clear display after message
    clear();
}
